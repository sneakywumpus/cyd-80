## sdkconfig.defaults
```kconfig
# optimize for performance
CONFIG_COMPILER_OPTIMIZATION_PERF=y
# enable -Wwrite-strings compiler warning
CONFIG_COMPILER_WARN_WRITE_STRINGS=y
# set target
CONFIG_IDF_TARGET="esp32"
# set minimum ESP32 revision to 3.0
CONFIG_ESP32_REV_MIN_3=y
# set CPU frequency to 240MHz
CONFIG_ESP_DEFAULT_CPU_FREQ_MHZ_240=y
# configure flash ROM
CONFIG_ESPTOOLPY_FLASHSIZE_4MB=y
CONFIG_ESPTOOLPY_FLASHMODE_QIO=y
CONFIG_ESPTOOLPY_FLASHFREQ_80M=y
# configure UART
#CONFIG_ESP_CONSOLE_UART_CUSTOM=y
#CONFIG_ESP_CONSOLE_UART_BAUDRATE=921600
# configure FATFS
CONFIG_FATFS_VFS_FSTAT_BLKSIZE=4096
# disable WiFi soft access point support
CONFIG_ESP_WIFI_SOFTAP_SUPPORT=n
# enable core dump to UART
CONFIG_ESP_COREDUMP_ENABLE_TO_UART=y
```
